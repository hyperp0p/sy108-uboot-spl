## src/u-boot/board/spreadtrum/udx710_4h10_recon/Kconfig
```kconfig
if TARGET_UDX710_4H10_RECON

config SYS_BOARD
	default "udx710_4h10_recon"

config SYS_VENDOR
	default "spreadtrum"

config SYS_SOC
	default "orca"

config SYS_CONFIG_NAME
	default "udx710_4h10_recon"

config SYS_TEXT_BASE
	default 0x9f000000

endif
```
